/**
 * ============================================================
 * ESP32-S3 OLED 显示屏学习示例
 * ============================================================
 * 
 * 学习目标：了解 OLED 屏幕的基本操作
 * 
 * 接线：
 *   OLED 模块    →  ESP32-S3
 *   VCC (电源+) →  3.3V (电源正极)
 *   GND (电源-) →  GND (电源负极/地)
 *   SCK (时钟线) →  GPIO 36 (I2C时钟信号)
 *   SDA (数据线) →  GPIO 37 (I2C数据信号)
 */

// ============================================================
// 第1步：加载库
// ============================================================

#include <Arduino.h>      // Arduino 基础库，提供 Serial、delay 等基本函数
#include <U8g2lib.h>      // OLED 显示屏库，用于控制屏幕显示

// ============================================================
// 第2步：定义引脚
// ============================================================

// I2C 通信引脚（OLED 屏幕用 I2C 总线通信）
#define OLED_SCL_PIN  36   // SCL/SCLK：I2C 时钟引脚
#define OLED_SDA_PIN  37   // SDA：I2C 数据引脚

// ============================================================
// 第3步：创建 OLED 对象
// ============================================================

// U8G2_SSD1306_128X32_UNIVISION_F_SW_I2C：屏幕型号
// 参数说明：
//   U8G2_R0：屏幕旋转角度，R0=0度（正常方向）
//   OLED_SCL_PIN：时钟引脚
//   OLED_SDA_PIN：数据引脚
//   U8X8_PIN_NONE：不用额外的引脚
U8G2_SSD1306_128X32_UNIVISION_F_SW_I2C u8g2(U8G2_R0, OLED_SCL_PIN, OLED_SDA_PIN, U8X8_PIN_NONE);

// ============================================================
// 第4步：全局变量
// ============================================================

int demoMode = 0;         // 当前演示模式（0-5）
const int TOTAL_DEMOS = 8; // 总共有几个演示（虽然只用到6个）

// ============================================================
// 演示1：显示文字
// ============================================================

void demoText() {
    // 清空屏幕缓冲区（类似画画前先擦掉之前的）
    u8g2.clearBuffer();
    
    // 设置字体
    // u8g2_font_ncenB08_tr：8像素高的等宽字体
    u8g2.setFont(u8g2_font_ncenB08_tr);
    
    // 绘制字符串
    // 参数：x坐标, y坐标, 要显示的文字
    // 注意：y是文字底部，不是顶部
    u8g2.drawStr(0, 12, "Hello OLED!");
    
    // 再显示一行
    u8g2.drawStr(0, 26, "ESP32-S3");
    
    // 把缓冲区发送到屏幕显示
    u8g2.sendBuffer();
}

// ============================================================
// 演示2：绘制几何图形
// ============================================================

void demoShapes() {
    u8g2.clearBuffer();  // 清空屏幕
    
    // 绘制空心矩形
    // 参数：左上角x, 左上角y, 宽度, 高度
    u8g2.drawFrame(0, 0, 30, 30);
    
    // 绘制实心矩形（填充的）
    // 参数：左上角x, 左上角y, 宽度, 高度
    u8g2.drawBox(35, 0, 30, 30);
    
    // 绘制空心圆
    // 参数：圆心x, 圆心y, 半径
    u8g2.drawCircle(80, 15, 15);
    
    // 绘制实心圆（填充的）
    u8g2.drawDisc(110, 15, 12);
    
    u8g2.sendBuffer();  // 显示
}

// ============================================================
// 演示3：进度条
// ============================================================

void demoProgressBar() {
    // static：静态变量，函数结束后值保留
    // 每次调用函数，progress 都会 +5，到100后回到0
    static int progress = 0;
    
    u8g2.clearBuffer();
    
    // 显示标题
    u8g2.setFont(u8g2_font_ncenB08_tr);
    u8g2.drawStr(0, 10, "Progress:");
    
    // 数字转字符串
    char buf[8];  // 临时存储字符串的数组
    // sprintf：格式化输出到字符串
    // %d%%：%d是数字，%%是百分号本身
    sprintf(buf, "%d%%", progress);
    
    // 换大字体显示数字
    u8g2.setFont(u8g2_font_lubB14_tr);
    u8g2.setCursor(70, 12);  // 设置光标位置
    u8g2.print(buf);  // 在光标位置打印数字
    
    // 绘制进度条背景（空心矩形）
    u8g2.drawFrame(0, 18, 128, 12);
    
    // 计算填充宽度
    // map(value, 原最小, 原最大, 新最小, 新最大)
    // 把 0-100 的数字，转换成 0-126 像素
    int fillWidth = map(progress, 0, 100, 0, 126);
    
    // 绘制填充矩形（实心的）
    // 参数：x, y, 宽度, 高度
    u8g2.drawBox(1, 19, fillWidth, 10);
    
    u8g2.sendBuffer();
    
    // 每次调用 +5，超过100就归零
    progress += 5;
    if (progress > 100) progress = 0;
    
    delay(200);  // 延时200毫秒
}

// ============================================================
// 演示4：移动的方块
// ============================================================

void demoMovingBox() {
    static int x = 0;     // 方块x坐标
    static int dir = 1;    // 移动方向：1=右，-1=左
    
    u8g2.clearBuffer();
    
    // 绘制实心矩形
    // 参数：左上角x, 左上角y, 宽度, 高度
    u8g2.drawBox(x, 10, 20, 15);
    
    u8g2.sendBuffer();
    
    // 移动方块
    x = x + dir * 3;  // 每次移动3个像素
    
    // 碰到边界就反弹
    if (x > 108 || x < 0) {
        dir = -dir;  // 反方向
    }
    
    delay(50);  // 延时50毫秒
}

// ============================================================
// 演示5：计数器
// ============================================================

void demoNumbers() {
    static int count = 0;  // 静态计数器
    
    u8g2.clearBuffer();
    
    // 显示标签
    u8g2.setFont(u8g2_font_ncenB08_tr);
    u8g2.drawStr(0, 10, "Counter:");
    
    // 显示数字（用大字体）
    u8g2.setFont(u8g2_font_lubB14_tr);
    u8g2.setCursor(0, 28);  // 设置光标位置
    u8g2.print(count);     // 打印数字
    
    u8g2.sendBuffer();
    
    count++;  // 每次 +1
    delay(500);  // 延时500毫秒
}

// ============================================================
// 第5步：初始化（程序启动时执行一次）
// ============================================================

void setup() {
    Serial.begin(115200);  // 启动串口，波特率115200
                          // 波特率：数据传输速度，越高越快
    
    u8g2.begin();         // 初始化OLED屏幕
    u8g2.clearBuffer();   // 清空屏幕缓冲区
    
    Serial.println("OLED 学习演示");
    Serial.println("发送数字 0-5 切换演示");
}

// ============================================================
// 第6步：主循环（反复执行）
// ============================================================

void loop() {
    // 检查串口是否有数据
    if (Serial.available()) {
        char cmd = Serial.read();  // 读取一个字符
        
        // 如果收到 0-5 的数字
        if (cmd >= '0' && cmd <= '5') {
            // cmd - '0'：把字符'0'-'5'转成数字0-5
            demoMode = cmd - '0';
        }
    }
    
    // 根据模式执行对应的演示函数
    switch (demoMode) {
        case 0: demoText(); break;         // 文字
        case 1: demoShapes(); break;       // 图形
        case 2: demoProgressBar(); break;   // 进度条
        case 3: demoMovingBox(); break;     // 移动方块
        case 4: demoNumbers(); break;       // 计数器
        case 5: demoText(); break;         // 也是文字（重复）
    }
}

/**
 * ============================================================
 * 常用函数速查表
 * ============================================================
 * 
 * 【初始化】
 * u8g2.begin()      - 启动屏幕
 * u8g2.clearBuffer() - 清空缓冲区
 * u8g2.sendBuffer()  - 把缓冲区画到屏幕
 * 
 * 【字体】
 * u8g2.setFont()    - 选择字体
 * u8g2.setCursor()  - 设置光标位置
 * u8g2.print()      - 打印内容
 * u8g2.drawStr()    - 绘制字符串
 * 
 * 【图形】
 * u8g2.drawPixel()  - 画点
 * u8g2.drawLine()    - 画线
 * u8g2.drawRect()    - 画矩形边框
 * u8g2.drawBox()     - 画实心矩形
 * u8g2.drawCircle()  - 画圆边框
 * u8g2.drawDisc()    - 画实心圆
 * 
 * 【常用字体】
 * u8g2_font_ncenB08_tr  - 标准8像素字体
 * u8g2_font_lubB14_tr  - 大号数字字体
 */